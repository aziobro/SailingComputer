## sdkconfig.defaults
```kconfig
# WiFi — ESP32-P4 host + ESP32-C6 slave via esp_hosted SDIO (Waveshare ESP32-P4-WIFI6)
# P4-side SDIO pins: CLK=18 CMD=19 D0=14 D1=15 D2=16 D3=17, C6 RST=54
CONFIG_SLAVE_IDF_TARGET_ESP32C6=y
CONFIG_ESP_HOSTED_CP_TARGET_ESP32C6=y
CONFIG_ESP_HOSTED_P4_DEV_BOARD_FUNC_BOARD=y
CONFIG_ESP_HOSTED_SDIO_HOST_INTERFACE=y
CONFIG_ESP_HOSTED_SDIO_SLOT_1=y
CONFIG_ESP_HOSTED_SDIO_4_BIT_BUS=y
CONFIG_ESP_HOSTED_SDIO_CLOCK_FREQ_KHZ=40000

# HTTP server — enough headroom for large headers and concurrent OTA + status
CONFIG_HTTPD_MAX_REQ_HDR_LEN=1024
CONFIG_HTTPD_MAX_URI_LEN=512
CONFIG_HTTPD_MAX_OPEN_SOCKETS=13

# BLE via SDIO (HCI over SDIO, no separate UART needed on Waveshare P4-WIFI6)
CONFIG_BT_ENABLED=y
CONFIG_BT_NIMBLE_ENABLED=y
CONFIG_BT_CONTROLLER_DISABLED=y
CONFIG_BT_NIMBLE_TRANSPORT_UART=n
CONFIG_ESP_HOSTED_ENABLE_BT_NIMBLE=y
CONFIG_ESP_HOSTED_NIMBLE_HCI_VHCI=y
CONFIG_BT_NIMBLE_MAX_CONNECTIONS=3
CONFIG_BT_NIMBLE_ROLE_OBSERVER_DISABLE=y
CONFIG_BT_NIMBLE_ROLE_CENTRAL_DISABLE=y
# Silence verbose NimBLE GATT/ATT internal logs (att_handle, GATT notify spam)
CONFIG_BT_NIMBLE_LOG_LEVEL_WARNING=y
CONFIG_BT_NIMBLE_LOG_LEVEL=1

# mDNS
CONFIG_MDNS_MAX_SERVICES=5

# HTTPS server
CONFIG_ESP_HTTPS_SERVER_ENABLE=y

# mbedTLS — 4096-byte TLS records are enough for our small responses and fit easily
# in heap. 16384 caused SSL_ALLOC_FAILED when Chrome opened 6+ parallel connections.
# TLS records chunk automatically so large responses (HTML page) still work fine.
CONFIG_MBEDTLS_SSL_MAX_CONTENT_LEN=4096
CONFIG_MBEDTLS_DYNAMIC_BUFFER=y
CONFIG_MBEDTLS_CERTIFICATE_BUNDLE_DEFAULT_FULL=n

# lwIP — raise global socket limit above the default of 10.
# HTTPS server (7) + HTTP redirect server (4) = 11 minimum; add headroom for NTRIP + TCP NMEA.
CONFIG_LWIP_MAX_SOCKETS=16

# OTA — allow plain HTTP (no TLS required on LAN)
CONFIG_OTA_ALLOW_HTTP=y
CONFIG_BOOTLOADER_APP_ROLLBACK_ENABLE=n

# Logging — INFO for app, suppress verbose bootloader output
CONFIG_LOG_DEFAULT_LEVEL_INFO=y
CONFIG_LOG_DEFAULT_LEVEL=3
CONFIG_BOOTLOADER_LOG_LEVEL_WARN=y
CONFIG_BOOTLOADER_LOG_LEVEL=2

# Main task stack size
CONFIG_ESP_MAIN_TASK_STACK_SIZE=8192

# FAT32 cards may contain user-supplied names longer than the 8.3 format.
CONFIG_FATFS_LFN_NONE=n
CONFIG_FATFS_LFN_HEAP=y

# ESP32-P4 silicon revision — Waveshare board uses rev 1.3 (< v3.0)
CONFIG_ESP32P4_SELECTS_REV_LESS_V3=y
CONFIG_ESP32P4_REV_MIN_1=y

# Flash size — Waveshare ESP32-P4-WIFI6 has 32MB NOR flash
CONFIG_ESPTOOLPY_FLASHSIZE_32MB=y
CONFIG_ESPTOOLPY_FLASHSIZE="32MB"

# Partition table — custom CSV in project root
CONFIG_PARTITION_TABLE_CUSTOM=y
CONFIG_PARTITION_TABLE_CUSTOM_FILENAME="partitions.csv"
```
